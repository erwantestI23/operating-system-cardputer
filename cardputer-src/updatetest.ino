#include <WiFi.h>
#include <HTTPClient.h>
#include "M5Cardputer.h"
const uint16_t epd_bitmap_img [] PROGMEM = {
  0x0000, 0x0000, 0x0000, 0x0000, 0x0000, 0x2104, 0x4a49, 0x632c, 0x6b6d, 0x738e, 0x738e, 0x738e, 0x738e, 0x738e, 0x738e, 0x738e, 
  0x738e, 0x738e, 0x738e, 0x738e, 0x738e, 0x738e, 0x738e, 0x738e, 0x738e, 0x738e, 0x738e, 0x738e, 0x738e, 0x738e, 0x738e, 0x738e, 
  0x738e, 0x738e, 0x738e, 0x738e, 0x738e, 0x738e, 0x738e, 0x738e, 0x738e, 0x738e, 0x738e, 0x738e, 0x738e, 0x6bad, 0x6bad, 0x6bad, 
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  0x0000, 0x0000, 0x0000, 0x0000
};

// Fonction pour afficher l'image avec transparence
void displayImageWithTransparency(int x, int y, int width, int height, const uint16_t *image) {
  int index = 0;
  for (int py = 0; py < height; py++) {
    for (int px = 0; px < width; px++) {
      uint16_t color = pgm_read_word(&image[index++]);
      if (color != 0x0000 && color != 0x2104 && color != 0x4A49 && color != 0x632C && color != 0x6B6D && color != 0x5ACB && color != 0x4208 && color != 0x18E3) { // 0x4208, 0x18e3
        M5.Lcd.drawPixel(x + px, y + py, color);
      }
    }
  }
}


int x = 240;
float a = -10.0;

const char* ssid = ":)";
const char* password = "";
const char* url = "https://raw.githubusercontent.com/erwantestI23/operating-system-cardputer/refs/heads/main/cardputer-src/version";
String currentVersion = "0.9.8"; // Version actuelle

void setup() {
  Serial.begin(115200);
  WiFi.begin(ssid, password);
  M5.begin();

  while (WiFi.status() != WL_CONNECTED) {
    delay(1000);
    Serial.println("Connexion au Wi-Fi...");
  }

  Serial.println("Wi-Fi connecté !");
  checkVersion(); // Vérifier la version au démarrage
}

void loop() {
  // Vous pouvez décider à quel intervalle vérifier la version
  delay(60000); // Vérifier toutes les 60 secondes
  checkVersion();
}

void checkVersion() {
  if (WiFi.status() == WL_CONNECTED) {
    HTTPClient http;
    http.begin(url);
    
    int httpCode = http.GET(); // Effectuer la requête GET
    
    if (httpCode > 0) {
      String payload = http.getString(); // Récupérer le contenu de la réponse
      payload.trim(); // Supprimer les espaces blancs autour
      
      Serial.println("Version du serveur : " + payload);
      
      if (payload != currentVersion) {
       // Serial.println("Nouvelle version détectée. Mise à jour en cours...");
        // Code pour effectuer l'action de mise à jour
        // Par exemple, télécharger un nouveau fichier, redémarrer le système, etc.
       // currentVersion = payload; // Mttre à jour la version actuelle
       for (int b = 0; b < 20; b++) {
   // M5.Lcd.fillScreen(0xCCCF); // Effacer l'écran à chaque étape
    a -= -0.5;
    x += a;
    displayImageWithTransparency(x, 90, 100, 45, epd_bitmap_img); // Afficher l'image avec transparence
    delay(15);
  }
      } else {
        Serial.println("La version est à jour.");
      }
    } else {
      Serial.println("Erreur lors de la requête HTTP");
    }
    
    http.end();
  }
}
